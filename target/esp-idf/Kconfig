## target/esp-idf/Kconfig
```kconfig
menu "Mender client"

    menu "General configuration"

        choice MENDER_SERVER_HOST
            prompt "Select which Mender server to use (hosted US, hosted EU, on-premise)"
            default MENDER_SERVER_HOST_US
            help
                Set the Mender server host URL to be used on the device.

            config MENDER_SERVER_HOST_US
                bool "https://hosted.mender.io"
                help
                    hosted Mender US
            config MENDER_SERVER_HOST_EU
                bool "https://eu.hosted.mender.io"
                help
                    hosted Mender EU
            config MENDER_SERVER_HOST_ON_PREM
                bool "On-premise server"
                help
                    Set the Mender server host URL to be used on the device.
            config MENDER_SERVER_HOST
                string "Mender server URL" if MENDER_SERVER_HOST_ON_PREM
                help
                    Specify a Mender server URL.
        endchoice

        config MENDER_SECONDARY_SERVER_HOST_DISABLE
            bool "Disable secondary/fallback Mender server URL (NOT RECOMMENDED)"
            default y
            help
                Disable secondary/fallback Mender server URL. This is HIGHLY UNRECOMMENDED because persistent
                connection issues using the primary Mender server URL can render the device permanently unreachable.

        config MENDER_SECONDARY_SERVER_HOST
            string "Secondary/fallback Mender server host (URL)"
            depends on MENDER_SECONDARY_SERVER_HOST_DISABLE=n
            default ""
            help
                Specify a fallback URL of the Mender server used when connections using the primary URL/hostname fail.

        if MENDER_SERVER_HOST_US
            config MENDER_SERVER_HOST
                default "https://hosted.mender.io"
        endif
        if MENDER_SERVER_HOST_EU
            config MENDER_SERVER_HOST
                default "https://eu.hosted.mender.io"
        endif

        config MENDER_SERVER_TENANT_TOKEN
            string "Mender server Tenant Token"
            help
                Set the Mender server Tenant Token, to be used with https://hosted.mender.io. Retrieve it from the "Organization and billing" settings of your account.

        choice MENDER_DEVICE_TIER
            prompt "Mender Device Tier"
            default MENDER_DEVICE_TIER_MICRO
            help
                Set the Device Tier to be used on the device (defaults to "micro"). Note that
                client configuration takes precedence.

            config MENDER_DEVICE_TIER_STANDARD
                bool "standard"
                help
                    Standard device tier
            config MENDER_DEVICE_TIER_MICRO
                bool "micro"
                help
                    Micro device tier
        endchoice

        config MENDER_DEVICE_TIER
            string
            default "standard" if MENDER_DEVICE_TIER_STANDARD
            default "micro" if MENDER_DEVICE_TIER_MICRO

        config MENDER_DEVICE_TYPE
            string "Mender Device Type"
            default IDF_TARGET
            help
                The type of device, used to ensure compatibility between the hardware and software.

        config MENDER_CLIENT_UPDATE_POLL_INTERVAL_DEFAULT
            int
            default 604800 if MENDER_DEVICE_TIER_MICRO
            default 1800 if MENDER_DEVICE_TIER_STANDARD

        config MENDER_CLIENT_UPDATE_POLL_INTERVAL
            int "Mender client Update poll interval (seconds)"
            range 1 2592000
            default MENDER_CLIENT_UPDATE_POLL_INTERVAL_DEFAULT
            help
                Interval used to periodically check for new deployments on the Mender server.
                The default value is once every 7 days for micro tier and once every 30 minutes for standard tier.

        config MENDER_LOG_LEVEL
            int "Mender client log level"
            range 0 4
            default 3
            help
                Log level for the Mender client: 0=off, 1=error, 2=warning, 3=info, 4=debug.

    endmenu

    menu "Inventory configuration"

        config MENDER_CLIENT_INVENTORY_REFRESH_INTERVAL_DEFAULT
            int
            default 604800 if MENDER_DEVICE_TIER_MICRO
            default 28800 if MENDER_DEVICE_TIER_STANDARD

        config MENDER_CLIENT_INVENTORY_REFRESH_INTERVAL
            int "Mender client Inventory refresh interval (seconds)"
            depends on MENDER_CLIENT_INVENTORY_DISABLE=n
            range 0 2592000
            default MENDER_CLIENT_INVENTORY_REFRESH_INTERVAL_DEFAULT
            help
                Interval used to periodically send inventory to the Mender server.
                Setting this value to 0 permits to disable the periodic execution and relies on the application to do it.
                The default value is once every 7 days for micro tier and once every 8 hours for standard tier.

        config MENDER_CLIENT_INVENTORY_DISABLE
            bool "Disable Mender client Inventory (EXPERIMENTAL)"
            default n
            help
                Compile out Mender Inventory. This is an experimental option not tested by
                the Mender Team. While it is possible to update a device with no inventory
                the features exposed through the Mender UI will be limited.

    endmenu

    menu "Storage options"

         config MENDER_STORAGE_PARTITION_LABEL
             string "Label of partition to store persistent Mender data"
             default "mender"
             help
                 Use "nvs" to use the ESP-IDF's default non-volatile storage partition (not recommended), or see
                 https://docs.espressif.com/projects/esp-idf/en/stable/esp32/api-guides/partition-tables.html#creating-custom-tables
                 for partition table definition docs and how to define a partition with label "mender".

    endmenu

    menu "Scheduler options (ADVANCED)"

        config MENDER_SCHEDULER_WORK_QUEUE_STACK_SIZE
            int "Mender Scheduler Work Queue Stack Size (kB)"
            range 1 64
            default 12
            help
                Mender scheduler work queue stack size, customize only if you have a deep understanding of the impacts! Default value is suitable for most applications.

        config MENDER_SCHEDULER_WORK_QUEUE_PRIORITY
            int "Mender Scheduler Work Queue Priority"
            range 1 24
            default 1
            help
                Mender scheduler work queue priority (higher number = higher priority), customize only if you have a deep understanding of the impacts! Default value is suitable for most applications.

        config MENDER_SCHEDULER_WORK_QUEUE_LENGTH
            int "Mender Scheduler Work Queue Length"
            range 1 64
            default 10
            help
                Mender scheduler work queue capacity (pending work items), customize only if you have a deep understanding of the impacts! Default value is suitable for most applications.

    endmenu

    menu "Optional functionality (ADVANCED)"

        config MENDER_FULL_PARSE_ARTIFACT
            bool "Full Mender Artifact parse"
            default y
            help
                Do full parsing of the Artifacts allowing for robustness feature of matching the device type

        config MENDER_PROVIDES_DEPENDS
            bool "Provides and depends functionality"
            default y
            help
                Opt-out to remove compatibility with v2 deployments/next API call and related functionality
            select MENDER_FULL_PARSE_ARTIFACT

        config MENDER_COMMIT_REQUIRE_AUTH
            bool "Authentication required for update commit"
            default y
            help
                Whether a successful authentication to the Mender server is a requirement for an update to be considered OK.
                WARNING: Disabling this can leave devices disconnected from the Mender forever! A similar check must be performed in the update module being used!

        menu "Error detection and recovery"

           config MENDER_MAX_STATE_DATA_STORE_COUNT
                int "Maximum number of state transitions before detecting a state loop during a deployment"
                range 1 255
                default 28
                help
                    If this limit is reached, a state loop is detected, and the deployment will be marked
                    as a failure.

            config MENDER_DETECT_NETWORK_ERRORS
                bool "Try to detect network errors and reset network to fix them"
                default y
                help
                    Whether Mender should try to detect network errors and attempt to fix them when there are too many.

            config MENDER_ERRORS_THRESHOLD_NET
                int "Network errors threshold"
                range 1 255
                default 10
                depends on MENDER_DETECT_NETWORK_ERRORS
                help
                    The number of errors triggering network reset.

            config MENDER_DETECT_REBOOT_ERRORS
                bool "Try to detect reboot errors and revert to normal operations instead of waiting for reboot forever"
                default y
                help
                    Whether Mender should try to detect it is waiting for too long after requesting a reboot.
                    Then it can mark the deployment (update) as failed and revert to normal operation, waiting for the next one.

            config MENDER_ERRORS_THRESHOLD_REBOOT
                int "Reboot waiting iterations threshold"
                range 1 255
                default 5
                depends on MENDER_DETECT_REBOOT_ERRORS
                help
                    The number of iterations to wait for a reboot.

        endmenu

    endmenu

    # Hidden symbol (no prompt) that is always enabled (default y), allowing us to unconditionally select dependencies
    config MENDER_FORCED_DEPS
        bool
        default y
        # Enables use of MbedTLS's internal CA bundle for verification
        select MBEDTLS_CERTIFICATE_BUNDLE_CROSS_SIGNED_VERIFY

endmenu
```
