## west.yml
```yaml
manifest:

  remotes:
    - name: mender
      url-base: https://github.com/mendersoftware

  projects:
    - name: cjson-zephyr
      submodules: true
      remote: mender
      path: modules/lib/cjson
      revision: 35dd41f010f66bedbd34d4ec2e5595ce74faf96f
```

## zephyr/Kconfig
```kconfig
# @file      Kconfig
# @brief     mender-mcu-client module Kconfig file
#
# Copyright joelguittet and mender-mcu-client contributors
#
# Licensed under the Apache License, Version 2.0 (the "License");
# you may not use this file except in compliance with the License.
# You may obtain a copy of the License at
#
#     http://www.apache.org/licenses/LICENSE-2.0
#
# Unless required by applicable law or agreed to in writing, software
# distributed under the License is distributed on an "AS IS" BASIS,
# WITHOUT WARRANTIES OR CONDITIONS OF ANY KIND, either express or implied.
# See the License for the specific language governing permissions and
# limitations under the License.

menuconfig MENDER_MCU_CLIENT
    bool "Mender Firmware Over-the-Air support"
    select CJSON
    select DNS_RESOLVER
    select FLASH
    select FLASH_MAP
    select HTTP_CLIENT
    select MPU_ALLOW_FLASH_WRITE
    select NETWORKING
    select NET_TCP
    select NET_SOCKETS
    select REBOOT
    select STREAM_FLASH
    help
        Secure, risk tolerant and efficient over-the-air updates for all device software.

if MENDER_MCU_CLIENT

    menu "General configuration"

        config MENDER_SERVER_HOST
            string "Mender server host URL"
            default "https://hosted.mender.io"
            help
                Set the Mender server host URL to be used on the device.

        config MENDER_SERVER_TENANT_TOKEN
            string "Mender server Tenant Token"
            help
                Set the Mender server Tenant Token, to be used with https://hosted.mender.io. Retrieve it from the "Organization and billing" settings of your account.

        config MENDER_CLIENT_AUTHENTICATION_POLL_INTERVAL
            int "Mender client Authentication poll interval (seconds)"
            range 0 3600
            default 600
            help
                Interval used to periodically try to authenticate to the Mender server until it succeeds.
                Setting this value to 0 permits to disable the periodic execution and relies on the application to do it.

        config MENDER_CLIENT_UPDATE_POLL_INTERVAL
            int "Mender client Update poll interval (seconds)"
            range 0 86400
            default 1800
            help
                Interval used to periodically check for new deployments on the Mender server.
                Setting this value to 0 permits to disable the periodic execution and relies on the application to do it.


        choice "MENDER_LOG_LEVEL_CHOICE"
            prompt "Max compiled-in log level for the Mender module"
            default MENDER_LOG_LEVEL_DEFAULT
            depends on LOG
            help
                Enables logging for Mender code.

            config MENDER_LOG_LEVEL_OFF
                bool "Off"

            config MENDER_LOG_LEVEL_ERR
                bool "Error"

            config MENDER_LOG_LEVEL_WRN
                bool "Warning"

            config MENDER_LOG_LEVEL_INF
                bool "Info"

            config MENDER_LOG_LEVEL_VRB
                bool "Verbose"

            config MENDER_LOG_LEVEL_DBG
                bool "Debug"

            config MENDER_LOG_LEVEL_DEFAULT
                bool "Default"
        endchoice

        config MENDER_LOG_LEVEL
            int
            depends on LOG
            default 0 if MENDER_LOG_LEVEL_OFF
            default 1 if MENDER_LOG_LEVEL_ERR
            default 2 if MENDER_LOG_LEVEL_WRN
            default 3 if MENDER_LOG_LEVEL_INF
            default 4 if MENDER_LOG_LEVEL_VRB
            default 5 if MENDER_LOG_LEVEL_DBG
            default LOG_DEFAULT_LEVEL if MENDER_LOG_LEVEL_DEFAULT

    endmenu

    menu "Inventory configuration"

        config MENDER_CLIENT_INVENTORY
            bool "Mender client Inventory"
            default y
            help
                Inventory permits to send inventory key-value pairs to the Mender server.
                It is particularly used to send artifact name and device type, and it permits to see the last check-in time of the device.

        if MENDER_CLIENT_INVENTORY

            config MENDER_CLIENT_INVENTORY_REFRESH_INTERVAL
                int "Mender client Inventory refresh interval (seconds)"
                range 0 86400
                default 28800
                help
                    Interval used to periodically send inventory to the Mender server.
                    Setting this value to 0 permits to disable the periodic execution and relies on the application to do it.

        endif

    endmenu

    menu "Update modules configuration"

        config MENDER_ZEPHYR_IMAGE_UPDATE_MODULE
            bool "The default Mender zephyr-image update module"
            default y
            select BOOTLOADER_MCUBOOT
            select IMG_ENABLE_IMAGE_CHECK
            select IMG_ERASE_PROGRESSIVELY
            select IMG_MANAGER
            help
                The default zephyr-image update module handles full Zephyr images on MCUboot-based devices.

    endmenu

    menu "Platform configuration (ADVANCED)"

        choice MENDER_PLATFORM_FLASH_TYPE
            prompt "Mender platform flash implementation type"
            default MENDER_PLATFORM_FLASH_TYPE_DEFAULT
            help
                Specify platform flash implementation type, select 'weak' to use you own implementation.

            config MENDER_PLATFORM_FLASH_TYPE_DEFAULT
                bool "default"
            config MENDER_PLATFORM_FLASH_TYPE_WEAK
                bool "weak"
        endchoice

        config MENDER_PLATFORM_FLASH_TYPE
            string
            default "zephyr" if MENDER_PLATFORM_FLASH_TYPE_DEFAULT
            default "generic/weak" if MENDER_PLATFORM_FLASH_TYPE_WEAK

        choice MENDER_PLATFORM_LOG_TYPE
            prompt "Mender platform log implementation type"
            default MENDER_PLATFORM_LOG_TYPE_DEFAULT
            help
                Specify platform log implementation type, select 'weak' to use you own implementation.

            config MENDER_PLATFORM_LOG_TYPE_DEFAULT
                bool "default"
            config MENDER_PLATFORM_LOG_TYPE_WEAK
                bool "weak"
        endchoice

        config MENDER_PLATFORM_LOG_TYPE
            string
            default "zephyr" if MENDER_PLATFORM_LOG_TYPE_DEFAULT
            default "generic/weak" if MENDER_PLATFORM_LOG_TYPE_WEAK

        choice MENDER_PLATFORM_NET_TYPE
            prompt "Mender platform network implementation type"
            default MENDER_PLATFORM_NET_TYPE_DEFAULT
            help
                Specify platform network implementation type, select 'weak' to use you own implementation.

            config MENDER_PLATFORM_NET_TYPE_DEFAULT
                bool "default"
            config MENDER_PLATFORM_NET_TYPE_WEAK
                bool "weak"
        endchoice

        config MENDER_PLATFORM_NET_TYPE
            string
            default "zephyr" if MENDER_PLATFORM_NET_TYPE_DEFAULT
            default "generic/weak" if MENDER_PLATFORM_NET_TYPE_WEAK

        choice MENDER_PLATFORM_SCHEDULER_TYPE
            prompt "Mender platform scheduler implementation type"
            default MENDER_PLATFORM_SCHEDULER_TYPE_DEFAULT
            help
                Specify platform scheduler implementation type, select 'weak' to use you own implementation.

            config MENDER_PLATFORM_SCHEDULER_TYPE_DEFAULT
                bool "default"
            config MENDER_PLATFORM_SCHEDULER_TYPE_WEAK
                bool "weak"
        endchoice

        config MENDER_PLATFORM_SCHEDULER_TYPE
            string
            default "zephyr" if MENDER_PLATFORM_SCHEDULER_TYPE_DEFAULT
            default "generic/weak" if MENDER_PLATFORM_SCHEDULER_TYPE_WEAK

        choice MENDER_PLATFORM_STORAGE_TYPE
            prompt "Mender platform storage implementation type"
            default MENDER_PLATFORM_STORAGE_TYPE_NVS
            help
                Specify platform storage implementation type, select 'weak' to use you own implementation.

            config MENDER_PLATFORM_STORAGE_TYPE_NVS
                bool "nvs"
                select NVS
            config MENDER_PLATFORM_STORAGE_TYPE_WEAK
                bool "weak"
        endchoice

        config MENDER_PLATFORM_STORAGE_TYPE
            string
            default "zephyr/nvs" if MENDER_PLATFORM_STORAGE_TYPE_NVS
            default "generic/weak" if MENDER_PLATFORM_STORAGE_TYPE_WEAK

        choice MENDER_PLATFORM_TLS_TYPE
            prompt "Mender platform TLS implementation type"
            default MENDER_PLATFORM_TLS_TYPE_MBEDTLS
            help
                Specify platform TLS implementation type, select 'weak' to use you own implementation.

            config MENDER_PLATFORM_TLS_TYPE_MBEDTLS
                bool "mbedtls"
                select MBEDTLS
            config MENDER_PLATFORM_TLS_TYPE_WEAK
                bool "weak"
        endchoice

        config MENDER_PLATFORM_TLS_TYPE
            string
            default "generic/mbedtls" if MENDER_PLATFORM_TLS_TYPE_MBEDTLS
            default "generic/weak" if MENDER_PLATFORM_TLS_TYPE_WEAK

    endmenu

    if MENDER_PLATFORM_NET_TYPE_DEFAULT

        menu "Network options (ADVANCED)"

            config MENDER_NET_CA_CERTIFICATE_TAG_PRIMARY
                int "Primary CA certificate tag for Server"
                default 1
                help
                    A primary security tag that ROOT CA server credential will be referenced with, typically used to authenicate the Mender Server. See tls_credential_add.

            config MENDER_NET_CA_CERTIFICATE_TAG_SECONDARY
                int "Secondary CA certificate tag for Artifacts"
                default 2
                help
                    A secondary security tag that ROOT CA server credential will be referenced with, typically used to authenticate the server from where to download Mender Artifacts. See tls_credential_add.

            config MENDER_NET_CA_CERTIFICATE_TAG_SECONDARY_ENABLED
                bool "Enable MENDER_NET_CA_CERTIFICATE_TAG_SECONDARY"
                default y
                help
                    Enables the secondary CA tag. If this option is enabled, the user must add the two certificates with tls_credential_add

            config MENDER_NET_TLS_PEER_VERIFY
                int "TLS_PEER_VERIFY option"
                range 0 2
                default 2
                help
                    Peer verification level for TLS connection.

        endmenu

    endif

    if MENDER_PLATFORM_SCHEDULER_TYPE_DEFAULT

        menu "Scheduler options (ADVANCED)"

            config MENDER_SCHEDULER_WORK_QUEUE_STACK_SIZE
                int "Mender Scheduler Work Queue Stack Size (kB)"
                range 0 64
                default 12
                help
                    Mender scheduler work queue stack size, customize only if you have a deep understanding of the impacts! Default value is suitable for most applications.

            config MENDER_SCHEDULER_WORK_QUEUE_PRIORITY
                int "Mender Scheduler Work Queue Priority"
                range 0 128
                default 5
                help
                    Mender scheduler work queue priority, customize only if you have a deep understanding of the impacts! Default value is suitable for most applications.

        endmenu

    endif

    if MENDER_PLATFORM_STORAGE_TYPE_NVS

        menu "Storage options"

            config MENDER_STORAGE_NVS_SECTOR_COUNT
                int "Number of sectors of the mender_storage partition"
                default 2
                range 2 8
                help
                    Number of sectors of the mender_storage partition, must match the configuration of the partition.

        endmenu

    endif

    menu "Optional functionality (ADVANCED)"

        config MENDER_FULL_PARSE_ARTIFACT
            bool "Full Mender Artifact parse"
            default y
            help
                Do full parsing of the Artifacts allowing for robustness feature of matching the device type

        config MENDER_PROVIDES_DEPENDS
            bool "Provides and depends functionality"
            default y
            help
                Opt-out to remove compatibility with v2 deployments/next API call and related functionality
            select MENDER_FULL_PARSE_ARTIFACT

    endmenu

endif
```
