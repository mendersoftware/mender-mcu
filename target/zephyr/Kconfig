## target/zephyr/Kconfig
```kconfig
# @file      Kconfig
# @brief     mender-mcu-client module Kconfig file
#
# Copyright joelguittet and mender-mcu-client contributors
# Copyright Northern.tech AS
#
# Licensed under the Apache License, Version 2.0 (the "License");
# you may not use this file except in compliance with the License.
# You may obtain a copy of the License at
#
#     http://www.apache.org/licenses/LICENSE-2.0
#
# Unless required by applicable law or agreed to in writing, software
# distributed under the License is distributed on an "AS IS" BASIS,
# WITHOUT WARRANTIES OR CONDITIONS OF ANY KIND, either express or implied.
# See the License for the specific language governing permissions and
# limitations under the License.

menuconfig MENDER_MCU_CLIENT
    bool "Mender Firmware Over-the-Air support"
    select CJSON
    select DNS_RESOLVER
    select FLASH
    select FLASH_MAP
    select HTTP_CLIENT
    select MPU_ALLOW_FLASH_WRITE
    select NETWORKING
    select NET_TCP
    select NET_SOCKETS
    select REBOOT
    select STREAM_FLASH
    help
        Secure, risk tolerant and efficient over-the-air updates for all device software.

if MENDER_MCU_CLIENT

    menu "General configuration"

        choice MENDER_SERVER_HOST
            prompt "Select which Mender server to use (hosted US, hosted EU, on-premise)"
            default MENDER_SERVER_HOST_US
            help
                Set the Mender server host URL to be used on the device.

            config MENDER_SERVER_HOST_US
                bool "https://hosted.mender.io"
                select MENDER_NET_CA_CERTIFICATE_TAG_SECONDARY_ENABLED
                help
                    hosted Mender US
            config MENDER_SERVER_HOST_EU
                bool "https://eu.hosted.mender.io"
                select MENDER_NET_CA_CERTIFICATE_TAG_SECONDARY_ENABLED
                help
                    hosted Mender EU
            config MENDER_SERVER_HOST_ON_PREM
                bool "On-premise server"
                help
                    Set the Mender server host URL to be used on the device.
            config MENDER_SERVER_HOST
                string "Mender server URL" if MENDER_SERVER_HOST_ON_PREM
                help
                    Specify a Mender server URL.
        endchoice

        if MENDER_SERVER_HOST_US
            config MENDER_SERVER_HOST
                default "https://hosted.mender.io"
        endif
        if MENDER_SERVER_HOST_EU
            config MENDER_SERVER_HOST
                default "https://eu.hosted.mender.io"
        endif

        config MENDER_SERVER_DORMANT_CERTIFICATES
            bool "Enable dormant certificate for potential server recovery"
            default y
            help
                Enable this option to install a dormant Let's Encrypt certificate on the device
                for potential server recovery scenarios. This certificate can be used to generate
                a new certificate in case the root certificate for the Mender server is revoked.
                It is strongly recommended to keep this option enabled to ensure server communication
                resilience in critical situations.

        config MENDER_SERVER_TENANT_TOKEN
            string "Mender server Tenant Token"
            help
                Set the Mender server Tenant Token, to be used with https://hosted.mender.io. Retrieve it from the "Organization and billing" settings of your account.

        choice MENDER_DEVICE_TIER
            prompt "Mender Device Tier"
            default MENDER_DEVICE_TIER_MICRO
            help
                Set the Device Tier to be used on the device (defaults to "micro"). Note that
                client configuration takes precedence.

            config MENDER_DEVICE_TIER_STANDARD
                bool "standard"
                help
                    Standard device tier
            config MENDER_DEVICE_TIER_MICRO
                bool "micro"
                help
                    Micro device tier
        endchoice

        config MENDER_DEVICE_TIER
            string
            default "standard" if MENDER_DEVICE_TIER_STANDARD
            default "micro" if MENDER_DEVICE_TIER_MICRO

        config MENDER_DEVICE_TYPE
            string "Mender Device Type"
            default BOARD
            help
                The type of device, used to ensure compatibility between the hardware and software.

        config MENDER_CLIENT_UPDATE_POLL_INTERVAL_DEFAULT
            int
            default 604800

        config MENDER_CLIENT_UPDATE_POLL_INTERVAL
            int "Mender client Update poll interval (seconds)"
            range 1 2592000
            default MENDER_CLIENT_UPDATE_POLL_INTERVAL_DEFAULT
            help
                Interval used to periodically check for new deployments on the Mender server.
                The default value is once every 7 days.

        config MENDER_DEPLOYMENT_LOGS
            bool "Deployment logs"
            default y
            select FCB
            help
                Enable the deployment logs feature. This is a feature that saves in non-volatile storage the Mender MCU warning and error logs during a deployment
                so that they can be sent to the Mender Server in case on a failed deployment for further diagnostics. It incurs flash wear and extra flash space
                requirements (see MENDER_STORAGE_DEPLOYMENT_LOGS_SECTORS).

        module = MENDER
        module-str = Log Level for mender
        module-help = Enables logging for mender code.
        source "subsys/logging/Kconfig.template.log_config"

    endmenu

    menu "Inventory configuration"

        config MENDER_CLIENT_INVENTORY_REFRESH_INTERVAL_DEFAULT
            int
            default 604800
        
        config MENDER_CLIENT_INVENTORY_REFRESH_INTERVAL
            int "Mender client Inventory refresh interval (seconds)"
            depends on MENDER_CLIENT_INVENTORY_DISABLE=n
            range 0 2592000
            default MENDER_CLIENT_INVENTORY_REFRESH_INTERVAL_DEFAULT
            help
                Interval used to periodically send inventory to the Mender server.
                Setting this value to 0 permits to disable the periodic execution and relies on the application to do it.
                The default value is once every 7 days.

        config MENDER_CLIENT_INVENTORY_BUILD_INFO
            bool "Build info built-in inventory"
            depends on MENDER_CLIENT_INVENTORY_DISABLE=n
            default y
            help
                Enable built-in build info inventory

        config MENDER_CLIENT_INVENTORY_NETWORK_INFO
            bool "Network info built-in inventory"
            depends on MENDER_CLIENT_INVENTORY_DISABLE=n
            default y
            help
                Enable built-in network info inventory

        config MENDER_CLIENT_INVENTORY_DISABLE
            bool "Disable Mender client Inventory (EXPERIMENTAL)"
            default n
            help
                Compile out Mender Inventory. This is an experimental option not tested by
                the Mender Team. While it is possible to update a device with no inventory
                the features exposed through the Mender UI will be limited.

    endmenu

    menu "Update modules configuration"

        config MENDER_ZEPHYR_IMAGE_UPDATE_MODULE
            bool "The default Mender zephyr-image update module"
            default y
            # The MCUboot options here do not
            # affect the MCUboot configuration
            select BOOTLOADER_MCUBOOT
            select MCUBOOT_MODE_SWAP_USING_MOVE
            select IMG_ENABLE_IMAGE_CHECK
            select IMG_ERASE_PROGRESSIVELY
            select IMG_MANAGER
            select MENDER_COMMIT_REQUIRE_AUTH
            help
                The default zephyr-image update module handles full Zephyr images on MCUboot-based devices.
                The MCUboot options selected here do not actually modify the behavior of the bootloader
                since it's built separately from the Mender MCU client. `BOOTLOADER_MCUBOOT`
                and `MCUBOOT_MODE_SWAP_USING_MOVE (`MCUBOOT_MODE_SWAP_WITHOUT_SCRATCH` for Zephyr versions below 4.1)`
                (or another swap algorithm) must be enabled in the bootloader configuration, e.g. `sysbuild.conf`
                if you're using sysbuild.
    endmenu

    menuconfig MENDER_ARTIFACT_GENERATE
        bool "Mender Artifact generation"
        default y
            help
                Auto-generates a Mender Artifact from the Zephyr kernel image. It requires the mender-artifact CLI tool
                installed in the workstation.

        if MENDER_ARTIFACT_GENERATE

            config MENDER_ARTIFACT_NAME
                string "Name of the artifact"
                help
                    Name of the artifact. Mandatory.

            config MENDER_ARTIFACT_TYPE
                string "Type of payload"
                default "zephyr-image" if MENDER_ZEPHYR_IMAGE_UPDATE_MODULE
                help
                    This is the same as the name of the update module. Mandatory.

            config MENDER_DEVICE_TYPES_COMPATIBLE
                string "Type of device(s) supported by the Artifact"
                default MENDER_DEVICE_TYPE
                help
                    It can specify more than one device types separated by spaces. Mandatory.

            config MENDER_ARTIFACT_PROVIDES
                string "Generic KEY:VALUE which is added to the type-info -> artifact_provides section."
                default ""
                help
                    It can specify more than one provides separated by spaces.

            config MENDER_ARTIFACT_DEPENDS
                string "Generic KEY:VALUE which is added to the type-info -> artifact_depends section.."
                default ""
                help
                    It can specify more than one depends separated by spaces.

            config MENDER_ARTIFACT_SOFTWARE_FILESYSTEM
                string "Base identifier for the device software"
                default "firmware"
                help
                    See also MENDER_ARTIFACT_SOFTWARE_NAME. The default Artifact provides will be composed
                    as MENDER_ARTIFACT_SOFTWARE_FILESYSTEM.MENDER_ARTIFACT_SOFTWARE_NAME.version=...

            config MENDER_ARTIFACT_SOFTWARE_NAME
                string "Update type identifier for the device software"
                default MENDER_ARTIFACT_TYPE
                help
                    See also MENDER_ARTIFACT_SOFTWARE_FILESYSTEM. The default Artifact provides will be composed
                    as MENDER_ARTIFACT_SOFTWARE_FILESYSTEM.MENDER_ARTIFACT_SOFTWARE_NAME.version=...

            config MENDER_ARTIFACT_EXTRA_ARGS
                string "Extra arguments for the Mender Artifact"
                default ""
                help
                    Passed verbatim to the mender-artifact CLI

            config MENDER_ARTIFACT_PAYLOAD_FILE
                string "User defined payload file for the Mender Artifact"
                default ""
                help
                    When not defined, the payload is the MCUBoot signed binary at ${ZEPHYR_BINARY_DIR}/${KERNEL_NAME}.signed.bin

            config MENDER_ARTIFACT_OUTPUT_FILE
                string "User defined output Mender Artifact file"
                default ""
                help
                    When not defined, the output file is ${ZEPHYR_BINARY_DIR}/${KERNEL_NAME}.mender

        menuconfig MENDER_ARTIFACT_SIZE_LIMITS
            bool "Artifact size limits"
            default y
                help
                    Enable size limits for Artifacts.
                        When enabled, you can configure limits to:
                        - Warn when Artifact size exceeds a given limit
                        - Fail the build and prevent artifact creation if size exceeds a maximum limit

                    Requires mender-artifact >= 4.2.0

            config MENDER_ARTIFACT_WARN_SIZE
                string "Warning limit for Artifact size"
                default "5MB"
                depends on MENDER_ARTIFACT_SIZE_LIMITS
                help
                    Warn if size of the Artifact exceeds the given limit.
                    Defaults to 5MB.
                    Leave empty to disable.
                    You can specify units: "123B", "1MB", etc. Supported units: B, KB, MB, GB, TB

            config MENDER_ARTIFACT_MAX_SIZE
                string "Maximum size"
                depends on MENDER_ARTIFACT_SIZE_LIMITS
                help
                    Fail build if size of the Artifact exceeds the given limit.
                    Leave empty to disable.
                    You can specify units: "123B", "1MB", etc. Supported units: B, KB, MB, GB, TB
        endif

    menu "Platform configuration (ADVANCED)"

        choice MENDER_PLATFORM_INVENTORY_TYPE
            prompt "Mender platform inventory implementation type"
            default MENDER_PLATFORM_INVENTORY_TYPE_DEFAULT
            help
                Specify platform inventory implementation type, select 'weak' to use you own implementation.

            config MENDER_PLATFORM_INVENTORY_TYPE_DEFAULT
                bool "default"
            config MENDER_PLATFORM_INVENTORY_TYPE_WEAK
                bool "weak"
        endchoice

        config MENDER_PLATFORM_INVENTORY_TYPE
            string
            default "zephyr" if MENDER_PLATFORM_INVENTORY_TYPE_DEFAULT
            default "generic/weak" if MENDER_PLATFORM_INVENTORY_TYPE_WEAK

        choice MENDER_PLATFORM_LOG_TYPE
            prompt "Mender platform log implementation type"
            default MENDER_PLATFORM_LOG_TYPE_DEFAULT
            help
                Specify platform log implementation type, select 'weak' to use you own implementation.

            config MENDER_PLATFORM_LOG_TYPE_DEFAULT
                bool "default"
            config MENDER_PLATFORM_LOG_TYPE_WEAK
                bool "weak"
        endchoice

        config MENDER_PLATFORM_LOG_TYPE
            string
            default "zephyr" if MENDER_PLATFORM_LOG_TYPE_DEFAULT
            default "generic/weak" if MENDER_PLATFORM_LOG_TYPE_WEAK

        choice MENDER_PLATFORM_MEM_TYPE
            prompt "Mender platform memory allocation implementation type"
            default MENDER_PLATFORM_MEM_TYPE_DEFAULT
            help
                Specify platform memory allocation implementation type.

            config MENDER_PLATFORM_MEM_TYPE_DEFAULT
                bool "default"
            config MENDER_PLATFORM_MEM_TYPE_GENERIC
                bool "generic"
        endchoice

        config MENDER_PLATFORM_MEM_TYPE
            string
            default "zephyr" if MENDER_PLATFORM_MEM_TYPE_DEFAULT
            default "generic" if MENDER_PLATFORM_MEM_TYPE_GENERIC

        choice MENDER_PLATFORM_NET_TYPE
            prompt "Mender platform network implementation type"
            default MENDER_PLATFORM_NET_TYPE_DEFAULT
            help
                Specify platform network implementation type, select 'weak' to use you own implementation.

            config MENDER_PLATFORM_NET_TYPE_DEFAULT
                bool "default"
            config MENDER_PLATFORM_NET_TYPE_WEAK
                bool "weak"
        endchoice

        config MENDER_PLATFORM_NET_TYPE
            string
            default "zephyr" if MENDER_PLATFORM_NET_TYPE_DEFAULT
            default "generic/weak" if MENDER_PLATFORM_NET_TYPE_WEAK

        choice MENDER_PLATFORM_SCHEDULER_TYPE
            prompt "Mender platform scheduler implementation type"
            default MENDER_PLATFORM_SCHEDULER_TYPE_DEFAULT
            help
                Specify platform scheduler implementation type, select 'weak' to use you own implementation.

            config MENDER_PLATFORM_SCHEDULER_TYPE_DEFAULT
                bool "default"
            config MENDER_PLATFORM_SCHEDULER_TYPE_WEAK
                bool "weak"
        endchoice

        config MENDER_PLATFORM_SCHEDULER_TYPE
            string
            default "zephyr" if MENDER_PLATFORM_SCHEDULER_TYPE_DEFAULT
            default "generic/weak" if MENDER_PLATFORM_SCHEDULER_TYPE_WEAK

        choice MENDER_PLATFORM_STORAGE_TYPE
            prompt "Mender platform storage implementation type"
            default MENDER_PLATFORM_STORAGE_TYPE_NVS
            help
                Specify platform storage implementation type, select 'weak' to use you own implementation.

            config MENDER_PLATFORM_STORAGE_TYPE_NVS
                bool "nvs"
                select NVS
            config MENDER_PLATFORM_STORAGE_TYPE_WEAK
                bool "weak"
        endchoice

        config MENDER_PLATFORM_STORAGE_TYPE
            string
            default "zephyr/nvs" if MENDER_PLATFORM_STORAGE_TYPE_NVS
            default "generic/weak" if MENDER_PLATFORM_STORAGE_TYPE_WEAK

        choice MENDER_PLATFORM_TLS_TYPE
            prompt "Mender platform TLS implementation type"
            default MENDER_PLATFORM_TLS_TYPE_MBEDTLS
            help
                Specify platform TLS implementation type, select 'weak' to use you own implementation.

            config MENDER_PLATFORM_TLS_TYPE_MBEDTLS
                bool "mbedtls"
                select MBEDTLS
            config MENDER_PLATFORM_TLS_TYPE_WEAK
                bool "weak"
        endchoice

        config MENDER_PLATFORM_TLS_TYPE
            string
            default "generic/mbedtls" if MENDER_PLATFORM_TLS_TYPE_MBEDTLS
            default "generic/weak" if MENDER_PLATFORM_TLS_TYPE_WEAK

        choice MENDER_PLATFORM_SHA_TYPE
            prompt "Mender platform SHA implementation type"
            default MENDER_PLATFORM_SHA_TYPE_MBEDTLS
            help
                Specify platform SHA implementation type, select 'weak' to use you own implementation.

            config MENDER_PLATFORM_SHA_TYPE_MBEDTLS
                bool "mbedtls"
                select MBEDTLS
            config MENDER_PLATFORM_SHA_TYPE_WEAK
                bool "weak"
        endchoice

        config MENDER_PLATFORM_SHA_TYPE
            string
            default "generic/mbedtls" if MENDER_PLATFORM_SHA_TYPE_MBEDTLS
            default "generic/weak" if MENDER_PLATFORM_SHA_TYPE_WEAK

        choice MENDER_PLATFORM_CERT_TYPE
            prompt "Mender platform certificate implementation type"
            default MENDER_PLATFORM_CERT_TYPE_DEFAULT
            help
                Specify platform certificate implementation type, select 'weak' to use you own implementation.

            config MENDER_PLATFORM_CERT_TYPE_DEFAULT
                bool "zephyr"
            config MENDER_PLATFORM_CERT_TYPE_WEAK
                bool "weak"
        endchoice

        config MENDER_PLATFORM_CERT_TYPE
            string
            default "zephyr" if MENDER_PLATFORM_CERT_TYPE_DEFAULT
            default "generic/weak" if MENDER_PLATFORM_CERT_TYPE_WEAK

    endmenu

    if MENDER_PLATFORM_MEM_TYPE_DEFAULT

        menu "Memory options (ADVANCED)"

            config MENDER_SEPARATE_HEAP
                bool "Use separate heap for Mender"
                default y
                help
                    Mender can either allocate dynamic memory from its own heap (default) or from the system heap.

            config MENDER_HEAP_SIZE
               int "Mender heap size (kB)"
               depends on MENDER_SEPARATE_HEAP
               default 8
               range 4 32
               help
                   Size of the Mender heap.

            config HEAP_MEM_POOL_ADD_SIZE_MENDER
               # Everything that starts with HEAP_MEM_POOL_ADD_SIZE_ contributes to the total
               # default size of the system heap.
               int "Mender extra system heap size (bytes)"
               depends on MENDER_SEPARATE_HEAP=n
               default 8192
               range 4096 32768
               help
                   How much extra space should Mender request in the system heap.

       endmenu

    endif

    if MENDER_PLATFORM_NET_TYPE_DEFAULT

        menu "Network options (ADVANCED)"

            config MENDER_NET_CA_CERTIFICATE_TAG_PRIMARY
                int "Primary CA certificate tag for Server"
                default 1
                help
                    A primary security tag that ROOT CA server credential will be referenced with, typically used to authenticate the Mender Server. See tls_credential_add.

            config MENDER_NET_CA_CERTIFICATE_TAG_SECONDARY
                int "Secondary CA certificate tag for Artifacts"
                default 2
                help
                    A secondary security tag that ROOT CA server credential will be referenced with, typically used to authenticate the server from where to download Mender Artifacts. See tls_credential_add.

            config MENDER_NET_CA_CERTIFICATE_TAG_DORMANT_A
                int "Dormant CA certificate A tag for Server rescue"
                # the tag is arbitrarily set to 9
                default 9
                depends on MENDER_SERVER_DORMANT_CERTIFICATES
                help
                    A security tag that the dormant certificate will be referenced with, typically used for backup in disaster recovery scenarios. See tls_credential_add.

            config MENDER_NET_CA_CERTIFICATE_TAG_DORMANT_B
                int "Dormant CA certificate B tag for Server rescue"
                # the tag is arbitrarily set to 10
                default 10
                depends on MENDER_SERVER_DORMANT_CERTIFICATES
                help
                    A security tag that the backup dormant certificate will be referenced with. See tls_credential_add.

            config MENDER_NET_CA_CERTIFICATE_TAG_SECONDARY_ENABLED
                bool "Enable MENDER_NET_CA_CERTIFICATE_TAG_SECONDARY"
                default n
                help
                    Enables the secondary CA tag. If this option is enabled, the user must add the two certificates with tls_credential_add

            config MENDER_NET_TLS_PEER_VERIFY
                int "TLS_PEER_VERIFY option"
                range 0 2
                default 2
                help
                    Peer verification level for TLS connection - see mbedtls/ssl.h, in particular mbedtls_ssl_conf_authmode(), for details. 2 (default) requires SSL peer verification, 1 makes verification optional (not implemented) and 0 skips verification.

            config MENDER_HTTP_REQUEST_TIMEOUT_MS
                int "The HTTP request timeout in milliseconds"
                default 300000 if MODEM_CELLULAR
                default 60000
                help
                    The timeout used by the HTTP request procedure. Defaults to one minute. If a cellular modem is used, the default is increased to 5 minutes.

            config MENDER_HTTP_PARSE_DATE_HEADER
                bool "Parse Date header for HTTP-date Retry-After"
                default n
                help
                    Enable parsing of the Date header from HTTP responses to calculate retry delays when
                    Retry-After is in HTTP-date format (e.g., "Sun, 26 Jan 2026 15:30:00 GMT").
                    This is only needed if the server returns Retry-After as an HTTP-date instead of
                    seconds. This is disabled by default as Mender Server returns the Retry-After value in
                    seconds rather than as a HTTP-date.
        endmenu

    endif

    if MENDER_PLATFORM_SCHEDULER_TYPE_DEFAULT

        menu "Scheduler options (ADVANCED)"

            config MENDER_SCHEDULER_SEPARATE_WORK_QUEUE
                bool "Use a separate work queue"
                default y
                help
                    Makes Mender start and use its own work queue instead of the system one

            config MENDER_SCHEDULER_WORK_QUEUE_STACK_SIZE
                int "Mender Scheduler Work Queue Stack Size (kB)"
                range 0 64
                default 6
                depends on MENDER_SCHEDULER_SEPARATE_WORK_QUEUE
                help
                    Mender scheduler work queue stack size, customize only if you have a deep understanding of the impacts! Default value is suitable for most applications.

            config MENDER_SCHEDULER_WORK_QUEUE_PRIORITY
                int "Mender Scheduler Work Queue Priority"
                range 0 128
                default 5
                depends on MENDER_SCHEDULER_SEPARATE_WORK_QUEUE
                help
                    Mender scheduler work queue priority, customize only if you have a deep understanding of the impacts! Default value is suitable for most applications.

        endmenu

    endif

    if MENDER_PLATFORM_STORAGE_TYPE_NVS

        menu "Storage options"

            choice MENDER_STORAGE_PARTITION
                prompt "Storage partition to use for Mender non-volatile data"
                default MENDER_STORAGE_PARTITION_MENDER_PARTITION
                help
                    "Which storage partition (defined in the Devicetree) Mender should use for storing non-volatile data"

                config MENDER_STORAGE_PARTITION_MENDER_PARTITION
                    bool "mender_partition"
                config MENDER_STORAGE_PARTITION_STORAGE_PARTITION
                    bool "storage_partition"
                config MENDER_STORAGE_PARTITION_CUSTOM
                    bool "a custom partition"
                    help
                        The `mender_err_t mender_get_storage_spec(const struct device **dev, int *part_id, uint16_t *sector_offset)` function has to
                        be implemented by the application and set the desired device (see FIXED_PARTITION_DEVICE() in Zephyr docs), partition ID
                        (FIXED_PARTITION_ID()) and sector offset, i.e. at which sector Mender data should start.
            endchoice

            config MENDER_STORAGE_SECTOR_OFFSET
                int "Mender data sector offset"
                default 0
                range 0 16
                depends on MENDER_STORAGE_PARTITION_STORAGE_PARTITION || MENDER_STORAGE_PARTITION_MENDER_PARTITION
                help
                    Which sector in the chosen partition should Mender data start at. This can be used to leave the first couple sectors in the chosen
                    partition reserved for other use. However, IT IS HIGHLY RECOMMENDED TO USE A WHOLE SEPARATE PARTITION for Mender data. If more
                    than 16 sectors are to be reserved for other use, custom partition specification has to be used.

            config MENDER_STORAGE_NVS_SECTOR_COUNT
                int "Number of sectors used for non-volatile data"
                default 2
                range 2 8
                help
                    Number of flash sectors used by Mender for necessary non-volatile data.

           config MENDER_STORAGE_DEPLOYMENT_LOGS_SECTORS
                int "Number of sectors available for deployment logs"
                default 2
                range 1 4
                depends on MENDER_DEPLOYMENT_LOGS
                help
                    Number of flash sectors for the Flash Circular Buffer storing deployment logs.

           config MENDER_STORAGE_DEPLOYMENT_DATA_CRC
                bool "Enable CRC check for deployment data"
                default y
                help
                    Enable CRC check for deployment data, this will add a CRC element to the end of the deployment data, which is verified when the data is read.

        endmenu

    endif

    menu "Optional functionality (ADVANCED)"

        config MENDER_FULL_PARSE_ARTIFACT
            bool "Full Mender Artifact parse"
            default y
            help
                Do full parsing of the Artifacts allowing for robustness feature of matching the device type

        config MENDER_PROVIDES_DEPENDS
            bool "Provides and depends functionality"
            default y
            help
                Opt-out to remove compatibility with v2 deployments/next API call and related functionality
            select MENDER_FULL_PARSE_ARTIFACT

        config MENDER_COMMIT_REQUIRE_AUTH
            bool "Authentication required for update commit"
            default y
            help
                Whether a successful authentication to the Mender server is a requirement for an update to be considered OK.
                WARNING: Disabling this can leave devices disconnected from the Mender forever! A similar check must be performed in the update module being used!

        menu "Error detection and recovery"

           config MENDER_MAX_STATE_DATA_STORE_COUNT
                int "Maximum number of state transitions before detecting a state loop during a deployment"
                range 1 255
                default 28
                help
                    If this limit is reached, a state loop is detected, and the deployment will be marked
                    as a failure.

            config MENDER_DETECT_NETWORK_ERRORS
                bool "Try to detect network errors and reset network to fix them"
                default y
                help
                    Whether Mender should try to detect network errors and attempt to fix them when there are too many.

            config MENDER_ERRORS_THRESHOLD_NET
                int "Network errors threshold"
                range 1 255
                default 10
                depends on MENDER_DETECT_NETWORK_ERRORS
                help
                    The number of errors triggering network reset.

            config MENDER_DETECT_REBOOT_ERRORS
                bool "Try to detect reboot errors and revert to normal operations instead of waiting for reboot forever"
                default y
                help
                    Whether Mender should try to detect it is waiting for too long after requesting a reboot.
                    Then it can mark the deployment (update) as failed and revert to normal operation, waiting for the next one.

            config MENDER_ERRORS_THRESHOLD_REBOOT
                int "Reboot waiting iterations threshold"
                range 1 255
                default 5
                depends on MENDER_DETECT_REBOOT_ERRORS
                help
                    The number of iterations to wait for a reboot.

            config MENDER_RETRY_ERROR_BACKOFF
                int "Backoff interval on retry errors (seconds)"
                range 0 3600
                default 60
                help
                    Starting interval for backoff on retry errors. The backoff algorithm will start at this
                    interval and double it for each retry.

            config MENDER_RETRY_ERROR_MAX_BACKOFF
                int "Maximum backoff on retry errors (seconds)"
                range 0 21600
                default 540
                help
                    Maximum backoff interval on retry errors. The backoff algorithm will increase until it reaches this
                    interval and continue retrying with the max interval.

        endmenu

    endmenu

endif
```
